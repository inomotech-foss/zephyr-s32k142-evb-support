## boards/nxp/s32k142_evb/Kconfig.defconfig
```kconfig
if BOARD_S32K142_EVB

if SERIAL

config UART_CONSOLE
	default y

endif # SERIAL

endif # BOARD_S32K142_EVB
```

## boards/nxp/s32k142_evb/s32k142_evb_defconfig
```kconfig
CONFIG_BUILD_OUTPUT_HEX=y

# Run from internal program flash
CONFIG_XIP=y

# Enable MPU
CONFIG_ARM_MPU=y

CONFIG_SERIAL=y
CONFIG_CONSOLE=y
```

## west.yml
```yaml
manifest:
  version: "1.2"
  remotes:
  - name: zephyrproject-rtos
    url-base: https://github.com/zephyrproject-rtos
  - name: inomotech-foss
    url-base: https://github.com/inomotech-foss

  projects:
  - name: zephyr
    remote: inomotech-foss
    revision: dd5ae6afd05544d770862ce3f7085f35b8ae9a7b
    import:
      name-allowlist:
      - "cmsis_6"
      - "cmsis"
      - "hal_nxp"
      - "zephyr-lang-rust"

  - name: hal_nxp
    remote: inomotech-foss
    repo-path: zephyr-hal-nxp
    revision: 01bac2bb068cffdc1c7e4946c1f16a25aaa462e6
    path: modules/hal/nxp

  - name: zephyr-lang-rust
    remote: inomotech-foss
    revision: 2b0addf93e7a93b3853da883f816a1b28234ca0c
    path: modules/lang/rust

  self:
    path: app
```
